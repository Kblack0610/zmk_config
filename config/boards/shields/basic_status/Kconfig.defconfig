## config/boards/shields/basic_status/Kconfig.defconfig
```kconfig
if SHIELD_BASIC_STATUS

config ZMK_DISPLAY
    default y

config LV_Z_MEM_POOL_SIZE
    default 4096

endif
```

## config/boards/shields/nice_opm_custom/Kconfig.shield
```kconfig
config SHIELD_NICE_OPM_CUSTOM
    def_bool $(shields_list_contains,nice_opm_custom)
```

## config/west.yml
```yaml
manifest:
  remotes:
    - name: zmkfirmware
      url-base: https://github.com/zmkfirmware
    - name: kblack0610
      url-base: https://github.com/kblack0610
    - name: whoop-t
      url-base: https://github.com/whoop-t
    - name: scybin
      url-base: https://github.com/scybin
  projects:
    - name: zmk
      remote: zmkfirmware
      revision: v0.3
      import: app/west.yml
    - name: nice-one-punch-ok
      remote: whoop-t
      revision: main
    - name: zmk-driver-pim447
      remote: scybin
      revision: master
  self:
    path: config
```
