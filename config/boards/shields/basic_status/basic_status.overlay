/*
 * Basic Status Shield Overlay
 * Provides Sharp LS0XX display device definition for nice!view
 * Screen content is provided by widgets/status.c via zmk_display_status_screen()
 * Requires nice_view_adapter to provide the nice_view_spi node
 */

&nice_view_spi {
    status = "okay";
    nice_view: ls0xx@0 {
        compatible = "sharp,ls0xx";
        spi-max-frequency = <1000000>;
        reg = <0>;
        width = <160>;
        height = <68>;
    };
};

/ {
    chosen {
        zephyr,display = &nice_view;
    };
};
